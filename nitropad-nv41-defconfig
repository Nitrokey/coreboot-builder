## nitropad-nv41-defconfig
```kconfig
CONFIG_LOCALVERSION="v1.7.2"
#CONFIG_CCACHE=y
CONFIG_USE_OPTION_TABLE=y
CONFIG_VENDOR_NOVACUSTOM=y
CONFIG_MAINBOARD_VERSION="v2.1"

CONFIG_MAINBOARD_VENDOR="Nitrokey"
CONFIG_MAINBOARD_SMBIOS_PRODUCT_NAME="NitroPad-NV41"
CONFIG_MAINBOARD_SMBIOS_MANUFACTURER="Nitrokey"

CONFIG_IFD_BIN_PATH="flashdescriptor.bin"
CONFIG_ME_BIN_PATH="me.bin"
CONFIG_HAVE_IFD_BIN=y
CONFIG_HAVE_ME_BIN=y

CONFIG_CONSOLE_CBMEM_BUFFER_SIZE=0x20000
CONFIG_PCIEXP_HOTPLUG_BUSES=42
CONFIG_PCIEXP_HOTPLUG_MEM=0xc200000
CONFIG_PCIEXP_HOTPLUG_PREFETCH_MEM=0x1c000000
CONFIG_BOARD_NOVACUSTOM_NV4X_ADLP=y
CONFIG_UART_PCI_ADDR=0x0
CONFIG_PCIEXP_HOTPLUG_PREFETCH_MEM_BELOW_4G=y
CONFIG_PCIEXP_HOTPLUG_IO=0x2000
CONFIG_SUBSYSTEM_VENDOR_ID=0x0000
CONFIG_SUBSYSTEM_DEVICE_ID=0x0000
CONFIG_I2C_TRANSFER_TIMEOUT_US=500000
CONFIG_SMMSTORE_SIZE=0x40000
CONFIG_CBFS_MCACHE_RW_PERCENTAGE=10
CONFIG_VBOOT_KEYBLOCK_VERSION=1
CONFIG_VBOOT_KEYBLOCK_PREAMBLE_FLAGS=0x0
CONFIG_TPM_MEASURED_BOOT=y

CONFIG_DRIVERS_EFI_VARIABLE_STORE=y
CONFIG_BOOTMEDIA_LOCK_CONTROLLER=y
CONFIG_BOOTMEDIA_LOCK_WPRO_VBOOT_RO=y
CONFIG_BOOTMEDIA_LOCK_IN_VERSTAGE=y
CONFIG_BOOTMEDIA_SMM_BWP=y
# CONFIG_CONSOLE_USE_LOGLEVEL_PREFIX is not set
# CONFIG_CONSOLE_USE_ANSI_ESCAPES is not set

CONFIG_EDK2_BOOT_TIMEOUT=2
CONFIG_EDK2_BOOTSPLASH_FILE="bootsplash.bmp"

CONFIG_PAYLOAD_EDK2=y
CONFIG_EDK2_REPOSITORY="https://github.com/Dasharo/edk2"
CONFIG_EDK2_TAG_OR_REV="b7274c98697e972e772236caf830c0780ec498bd"
CONFIG_EDK2_USE_EDK2_PLATFORMS=y
CONFIG_EDK2_PLATFORMS_REPOSITORY="https://github.com/Dasharo/edk2-platforms"
CONFIG_EDK2_PLATFORMS_TAG_OR_REV="3323ed481d35096fb6a7eae7b49f35eff00f86cf"
CONFIG_EDK2_FOLLOW_BGRT_SPEC=y
CONFIG_EDK2_SKIP_PS2_DETECT=y
CONFIG_EDK2_ENABLE_IPXE=y
CONFIG_EDK2_SECURE_BOOT=y
# CONFIG_EDK2_SECURE_BOOT_DEFAULT_ENABLE is not set
CONFIG_EDK2_SETUP_PASSWORD=y
CONFIG_EDK2_DASHARO_SYSTEM_FEATURES=y
CONFIG_EDK2_DASHARO_SECURITY_OPTIONS=y
CONFIG_EDK2_SHOW_CAMERA_OPTION=y
CONFIG_EDK2_SHOW_WIFI_BT_OPTION=y
CONFIG_EDK2_DASHARO_INTEL_ME_OPTIONS=y
CONFIG_EDK2_DASHARO_USB_CONFIG=y
CONFIG_EDK2_DASHARO_NETWORK_CONFIG=y
CONFIG_EDK2_DASHARO_POWER_CONFIG=y
CONFIG_EDK2_SLEEP_TYPE_OPTION=y
CONFIG_EDK2_FAN_CURVE_OPTION=y
CONFIG_EDK2_BATTERY_CONFIG_OPTION=y
CONFIG_EDK2_BOOT_MENU_KEY=0x0011
CONFIG_EDK2_SETUP_MENU_KEY=0x000C
CONFIG_EDK2_ENABLE_BATTERY_CHECK=y
CONFIG_EDK2_PRINT_SOL_STRINGS=y
CONFIG_EDK2_CBMEM_LOGGING=y
CONFIG_EDK2_SYSTEM76_EC_LOGGING=y
CONFIG_EDK2_SERIAL_SUPPORT=y
CONFIG_EDK2_PERFORMANCE_MEASUREMENT_ENABLE=y
CONFIG_PXE_ADD_SCRIPT=y
CONFIG_PXE_SCRIPT="3rdparty/dasharo-blobs/dasharo/dasharo.ipxe"
CONFIG_PXE_CUSTOM_BUILD_ID="0123456789"
```

## nitropc-defconfig
```kconfig
CONFIG_VENDOR_PURISM=y
CONFIG_MAINBOARD_VENDOR="Nitrokey"
CONFIG_INTEL_GMA_VBT_FILE="vbt.bin"
CONFIG_IFD_BIN_PATH="flashdescriptor.bin"
CONFIG_ME_BIN_PATH="me.bin"
CONFIG_MAINBOARD_SMBIOS_PRODUCT_NAME="NitroPC"
CONFIG_HAVE_IFD_BIN=y
CONFIG_BOARD_PURISM_LIBREM_MINI_V2=y
CONFIG_CPU_MICROCODE_CBFS_EXTERNAL_BINS=y
CONFIG_CPU_UCODE_BINARIES="cpu_microcode_blob.bin"
CONFIG_HAVE_ME_BIN=y
CONFIG_PAYLOAD_TIANOCORE=y
CONFIG_TIANOCORE_BOOTSPLASH_IMAGE=y
```

## nitrowall-defconfig
```kconfig
CONFIG_VENDOR_PROTECTLI=y
CONFIG_MAINBOARD_VENDOR="Nitrokey"
CONFIG_VGA_BIOS=y
CONFIG_MAINBOARD_SMBIOS_PRODUCT_NAME="NitroWall"
CONFIG_BOARD_PROTECTLI_FW4B=y
CONFIG_VGA_ROM_RUN=y
CONFIG_ON_DEVICE_ROM_LOAD=y
CONFIG_SMMSTORE=y

CONFIG_USE_ME_CLEANER=y

CONFIG_HAVE_IFD_BIN=y
CONFIG_IFD_BIN_PATH="fd.bin"

CONFIG_HAVE_ME_BIN=y
CONFIG_ME_BIN_PATH="me.bin"
```

## nitrowall-pro-defconfig
```kconfig
CONFIG_LOCALVERSION="4.12"
CONFIG_BOOTSPLASH_IMAGE=y
CONFIG_BOOTSPLASH_FILE="bootsplash.jpg"
CONFIG_VENDOR_PROTECTLI=y
CONFIG_VGA_BIOS=y
CONFIG_VGA_BIOS_FILE="vgabios.bin"
CONFIG_VGA_BIOS_SECOND=y
CONFIG_VGA_BIOS_SECOND_FILE="vgabios2.bin"
CONFIG_HAVE_IFD_BIN=y
CONFIG_BOARD_PROTECTLI_FW6=y
CONFIG_HAVE_ME_BIN=y
CONFIG_MAINBOARD_VENDOR="Nitrokey"
CONFIG_MAINBOARD_SMBIOS_PRODUCT_NAME="NitroWall-NW678"
CONFIG_USE_ME_CLEANER=y
CONFIG_IFD_BIN_PATH="fd.bin"
CONFIG_ME_BIN_PATH="me.bin"


CONFIG_DEFAULT_CONSOLE_LOGLEVEL_0=y
CONFIG_SEABIOS_DEBUG_LEVEL=0
```
