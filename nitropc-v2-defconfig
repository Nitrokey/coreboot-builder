## nitropc-v2-defconfig
```kconfig
CONFIG_USE_OPTION_TABLE=y
CONFIG_STATIC_OPTION_TABLE=y
CONFIG_VENDOR_PURISM=y
CONFIG_MAINBOARD_VENDOR="Nitrokey"
CONFIG_INTEL_GMA_VBT_FILE="vbt.bin"
CONFIG_IFD_BIN_PATH="flashdescriptor.bin"
CONFIG_ME_BIN_PATH="me.bin"
CONFIG_CONSOLE_CBMEM_BUFFER_SIZE=0x100000
CONFIG_MAINBOARD_SMBIOS_PRODUCT_NAME="NitroPC"
CONFIG_HAVE_IFD_BIN=y
CONFIG_BOARD_PURISM_LIBREM_MINI_V2=y
CONFIG_EDK2_BOOTSPLASH_FILE="bootsplash.jpg"
CONFIG_TPM2=y
#CONFIG_TPM_MEASURED_BOOT=y
CONFIG_HAVE_ME_BIN=y
CONFIG_RUN_FSP_GOP=y
CONFIG_PAYLOAD_EDK2=y
CONFIG_EDK2_BOOT_MANAGER_ESCAPE=y
CONFIG_EDK2_CBMEM_LOGGING=y
CONFIG_EDK2_FOLLOW_BGRT_SPEC=y

# CONFIG_DEBUG_TPM=y
# CONFIG_DEFAULT_CONSOLE_LOGLEVEL=8
# CONFIG_DEFAULT_CONSOLE_LOGLEVEL_8=y

CONFIG_SOC_INTEL_COMMON_BLOCK_HECI1_DISABLE_USING_PMC_IPC=n

CONFIG_TPM_MEASURED_BOOT_INIT_BOOTBLOCK=y
```
